## sys/sched_feedback/Kconfig
```kconfig
# Copyright (c) 2021 TUBA Freiberg
#
# This file is subject to the terms and conditions of the GNU Lesser
# General Public License v2.1. See the file LICENSE in the top level
# directory for more details.
#

config  MODULE_SCHED_FEEDBACK
    bool "feedback scheduling support"
    depends on MODULE_ZTIMER_MSEC || MODULE_ZTIMER_USEC
    depends on TEST_KCONFIG
    select MODULE_SCHED_RUNQUEUE_API

if MODULE_SCHED_FEEDBACK
config SCHED_RR_TIMEOUT
    int "timeout for feedback scheduling"
    default 10000

endif
```
